## examples/mqtt_tcp/sdkconfig.defaults
```kconfig
# Override some defaults so BT stack is enabled

CONFIG_BROKER_KEEPALIVE=60

# CONFIG_ESP_WIFI_STA_SSID="test"
# CONFIG_ESP_WIFI_STA_PASSWORD="12345678"
```

## examples/mqtt_tcp/sdkconfig.defaults.esp32c2
```kconfig
# Override some defaults so BT stack is enabled
CONFIG_IDF_TARGET="esp32c2"
CONFIG_ESP_DEFAULT_CPU_FREQ_MHZ_120=y

#
# Main XTAL Config
#
CONFIG_XTAL_FREQ_26=y
CONFIG_XTAL_FREQ=26

CONFIG_BROKER_URL="mqtt://192.168.0.101:1883"
CONFIG_BROKER_USER="esp32c2"
CONFIG_BROKER_PASSWORD="12345678"

CONFIG_ESP32_WIFI_AMPDU_RX_ENABLED=y

CONFIG_ESPTOOLPY_MONITOR_BAUD=115200
CONFIG_ESP_CONSOLE_UART_BAUDRATE=115200

# CONFIG_ESP_CONSOLE_UART_DEFAULT is not set
CONFIG_ESP_CONSOLE_UART_CUSTOM=y
CONFIG_ESP_CONSOLE_UART=y
CONFIG_ESP_CONSOLE_UART_NUM=0
CONFIG_ESP_CONSOLE_UART_TX_GPIO=20
CONFIG_ESP_CONSOLE_UART_RX_GPIO=19
CONFIG_ESP_CONSOLE_UART_BAUDRATE=115200
```

## examples/mqtt_tcp/sdkconfig.defaults.esp32c3
```kconfig
# Override some defaults so BT stack is enabled
CONFIG_IDF_TARGET="esp32c3"

CONFIG_BROKER_URL="mqtt://124.221.183.171:1883"
CONFIG_BROKER_USER="esp32c3"
CONFIG_BROKER_PASSWORD="12345678"


CONFIG_ESP32_WIFI_AMPDU_RX_ENABLED=y
CONFIG_ESP32_WIFI_AMPDU_TX_ENABLED=y
```

## examples/mqtt_tcp/sdkconfig.defaults.esp32s2
```kconfig
# Override some defaults so BT stack is enabled
CONFIG_IDF_TARGET="esp32s2"
CONFIG_BT_CTRL_DFT_TX_POWER_LEVEL_P18=y
CONFIG_BT_CTRL_DFT_TX_POWER_LEVEL_EFF=14
```

## examples/mqtt_tcp/sdkconfig.defaults.esp32s3
```kconfig
# Override some defaults 
CONFIG_IDF_TARGET="esp32s3"
CONFIG_BT_CTRL_DFT_TX_POWER_LEVEL_P18=y
CONFIG_BT_CTRL_DFT_TX_POWER_LEVEL_EFF=14
```

## src/demo/esp32c3_sandbox/main/Kconfig.projbuild
```kconfig
menu "Digital LED Config"
    config DIGITAL_LED_OUTPUT_PIN
        int "LED output pin"
        range 0 34
        default 8
        help
            GPIO pin connected to the DIN of the digital LEDs.

    config NUMBER_OF_LEDS
        int "Number of digital LEDs"
        range 0 100
        default 1
        help
            The number of digital LEDs connected in series.
endmenu
```
